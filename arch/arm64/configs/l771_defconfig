## arch/arm64/configs/l771_defconfig
```kconfig
#
# Hisense product Infomation
#
CONFIG_MACH_HISENSE_SMARTPHONE=y
CONFIG_HISENSE_VENDOR_NAME="Hisense"
CONFIG_HISENSE_PRODUCT_NAME="L771"
#
# Hisense charger function support
#
CONFIG_FUSB_30X=y
CONFIG_HISENSE_SGM41512_CHARGER=y
CONFIG_HISENSE_BATTERY_THERM_NTC_10K=y

CONFIG_BACKLIGHT_AW99703=y
#
# Hisense fingerprint device support
#
CONFIG_HS_FINGERPRINT=y
CONFIG_FINGERPRINT_SUNWAVE=y
CONFIG_FINGERPRINT_FPC_FPC1542=y
CONFIG_FINGERPRINT_VENDOR_CHECK=y
CONFIG_TOUCHSCREEN_SITRONIX_TS=y
CONFIG_TOUCHSCREEN_SITRONIX_TS_POWER_SUPPLY_EN=y
CONFIG_TOUCHSCREEN_SITRONIX_TS_GLOVE=y
CONFIG_TOUCHSCREEN_SITRONIX_TS_GESTURE=y
# CONFIG_FT_SECURE_TOUCH is not set
CONFIG_TOUCHSCREEN_USB_CHECK=y
CONFIG_TOUCHSCREEN_WORK_MODE=y
CONFIG_BACKLIGHT_AW99703=y
#
# Hisense fuse status support
#
CONFIG_MMC_FFU=y

#
# Hisense fingerprint device support
#
CONFIG_HS_FINGERPRINT=y
CONFIG_FINGERPRINT_SUNWAVE=y

CONFIG_SD_ERR_CHECK=y
CONFIG_NFC_NQ=y
CONFIG_HMCT_CAMERA_DEBUG=y
CONFIG_HMCT_LOW_BATTERY_FLASH_CTL=y
```

## arch/arm64/configs/l820_defconfig
```kconfig
#
# Hisense product Infomation
#
CONFIG_MACH_HISENSE_SMARTPHONE=y
CONFIG_HISENSE_VENDOR_NAME="Hisense"
CONFIG_HISENSE_PRODUCT_NAME="l820"
#
# Hisense charger function support
#
CONFIG_FUSB_30X=y
CONFIG_HISENSE_SGM41512_CHARGER=y
#CONFIG_HISENSE_BATTERY_THERM_NTC_10K is not set

CONFIG_BACKLIGHT_AW99703=y
CONFIG_INPUT_TOUCHSCREEN=y
CONFIG_OF_TOUCHSCREEN=y
CONFIG_TOUCHSCREEN_FTS=y
CONFIG_TOUCHSCREEN_FTS_DIRECTORY="focaltech_touch"
CONFIG_TOUCHSCREEN_FTS_GLOVE=y
CONFIG_TOUCHSCREEN_FTS_GESTURE=y
# CONFIG_TOUCHSCREEN_FT5X06 is not set
# CONFIG_FT_INCELL_CHIP is not set
# CONFIG_TOUCHSCREEN_FT5X06_GESTURE is not set
# CONFIG_TOUCHSCREEN_FT5X06_GESTURE_DRIVER is not set
# CONFIG_TOUCHSCREEN_FACE_DETECTION is not set
# CONFIG_TOUCHSCREEN_FT5X06_GLOVE is not set
# CONFIG_TOUCHSCREEN_FT5X06_GFF_PANNEL=y
# CONFIG_TOUCHSCREEN_FT5X06_HALL is not set
# CONFIG_TOUCHSCREEN_FT5X06_PRAMUPDATE is not set
# CONFIG_TOUCHSCREEN_FT5X06_APK_TEST is not set
# CONFIG_TOUCHSCREEN_FT5X06_SUB is not set
# CONFIG_FT_SECURE_TOUCH is not set
CONFIG_TOUCHSCREEN_USB_CHECK=y
CONFIG_TOUCHSCREEN_FTS_FH=y
# CONFIG_TOUCHSCREEN_FT5X06_FH is not set
CONFIG_TOUCHSCREEN_WORK_MODE=y
CONFIG_BACKLIGHT_AW99703=y
#
# Hisense fuse status support
#
CONFIG_QCOM_CHIP_EFUSE=y
CONFIG_MMC_FFU=y

#
# Hisense AP-side sensor support
#
CONFIG_SENSOR_HALL=y

#
# Hisense fingerprint device support
#

CONFIG_SD_ERR_CHECK=y
CONFIG_HISENSE_SD_POWER_OFF_QUICK=y
CONFIG_NFC_NQ=y
CONFIG_HISENSE_QPNP_REG_DEBUG=y
CONFIG_HMCT_CAMERA_DEBUG=y
CONFIG_PROJECTNAME_REPORT=y
CONFIG_HMCT_LOW_BATTERY_FLASH_CTL=y
CONFIG_HMCT_FC_SAFETY_TIMER_1536M=y
```

## drivers/input/touchscreen/focaltech_touch/Kconfig
```kconfig
#
# Focaltech Touchscreen driver configuration
#

#config TOUCHSCREEN_FTS
#    bool "Focaltech Touchscreen"
 #   default n
  #  help
    #  Say Y here if you have Focaltech touch panel.
     # If unsure, say N.
      
config TOUCHSCREEN_FTS_DIRECTORY
    string "Focaltech ts directory name"
    default "focaltech_touch"
    depends on TOUCHSCREEN_FTS
config TOUCHSCREEN_FTS_GLOVE
       bool "FocalTech touchscreens glove mode function realized in driver"
       depends on TOUCHSCREEN_FTS
       help
         Say Y here if you need a FT5526-003 glove mode in driver.
	 else say N
config TOUCHSCREEN_FTS_GESTURE
       bool "FocalTech touchscreens gesture function"
       depends on TOUCHSCREEN_FTS
       help
         Say Y here if you need a FT5526-003 touchscreen gesture function.
	 else say N
config TOUCHSCREEN_FTS_FH
       bool "FocalTech touchscreens FH support."
       depends on TOUCHSCREEN_USB_CHECK
       help
         Say Y here if you need a FT5526-003 touchscreen FH function.
      #else say N
 
```

## drivers/sensors/HS_SNS_DRV/Kconfig
```kconfig
#
# SPRD Sensor Hub drivers configuration
#

config SENSOR_HALL
	bool "Provide Hall Device Support"
	default n
	help
	  Say Y here, select hall chip .
```

## drivers/sensors/Kconfig
```kconfig
config SENSORS_SSC
	bool "Enable Sensors Driver Support for SSC"
	help
	  Add support for sensors SSC driver.
	  This driver is used for exercising sensors use case,
	  time syncing with ADSP clock.

source "drivers/sensors/HS_SNS_DRV/Kconfig"
```

## drivers/soc/hisense/audio/Kconfig
```kconfig
config HISENSE_ACCESS_DIAG_PARTITION
	depends on HISENSE_DEBUG_CTRL
	bool "get info from diag partition"
	default y
	help
	  Provide a methed to get info from diag partition.
```

## drivers/soc/hisense/debug/Kconfig
```kconfig
config PRINTK_PROCESS_INFO
	bool "add print process pid and name"
	depends on MACH_HISENSE_SMARTPHONE
	default n
	help
	  Enable it when want to add the process info for printk
```

## drivers/staging/typec/Kconfig
```kconfig
menu "USB Power Delivery and Type-C drivers"

config TYPEC_TCPM
	tristate "USB Type-C Port Controller Manager"
	depends on USB
	select TYPEC
	help
	  The Type-C Port Controller Manager provides a USB PD and USB Type-C
	  state machine for use with Type-C Port Controllers.

if TYPEC_TCPM

config TYPEC_TCPCI
	tristate "Type-C Port Controller Interface driver"
	depends on I2C
	select REGMAP_I2C
	help
	  Type-C Port Controller driver for TCPCI-compliant controller.


source "drivers/staging/typec/fusb302/Kconfig"

endif

config FUSB_30X
	tristate "Fairchild FUSB302 Type-C chip driver"
	depends on I2C
	help
	  The Fairchild FUSB302 Type-C chip driver that works with
	  Type-C Port Controller Manager to provide USB PD and USB
	  Type-C functionalities.

config FUSB_PD_SNK_9VCHG
         tristate "Support Fix PD 9V Charging"
         help
           Say Y to support Fix PD2.0 9V PDO. This add to support PD2.0
           9V PDO charging.

endmenu
```
