/* Copyright (c) 2018, The Linux Foundation. All rights reserved.
 *
 * This program is free software; you can redistribute it and/or modify
 * it under the terms of the GNU General Public License version 2 and
 * only version 2 as published by the Free Software Foundation.
 *
 * This program is distributed in the hope that it will be useful,
 * but WITHOUT ANY WARRANTY; without even the implied warranty of
 * MERCHANTABILITY or FITNESS FOR A PARTICULAR PURPOSE.  See the
 * GNU General Public License for more details.
 */

&mdss_mdp {
	dsi_st7703_boe_hdp_vid: qcom,mdss_dsi_st7703_boe_hdp_video{
		qcom,mdss-dsi-panel-name = "st7703 boe hd plus";
		qcom,mdss-dsi-panel-type = "dsi_video_mode";
		//qcom,dsi-ctrl-num = <0>;
		//qcom,dsi-phy-num = <0>;

		qcom,mdss-dsi-virtual-channel-id = <0>;
		qcom,mdss-dsi-stream = <0>;

		qcom,mdss-dsi-h-left-border = <0>;
		qcom,mdss-dsi-h-right-border = <0>;
		qcom,mdss-dsi-v-top-border = <0>;
		qcom,mdss-dsi-v-bottom-border = <0>;

		qcom,mdss-dsi-bpp = <24>;
		qcom,mdss-dsi-color-order = "rgb_swap_rgb";
		qcom,mdss-dsi-underflow-color = <0xff>;
		qcom,mdss-dsi-border-color = <0>;


		qcom,mdss-dsi-h-sync-pulse = <0>;
		qcom,mdss-dsi-traffic-mode = "burst_mode";
		qcom,mdss-dsi-lane-map = "lane_map_0123";
		qcom,mdss-dsi-bllp-eof-power-mode;
		qcom,mdss-dsi-bllp-power-mode;
		qcom,mdss-dsi-tx-eot-append;
		//qcom,mdss-dsi-hfp-power-mode;//
		qcom,mdss-dsi-lane-0-state;
		qcom,mdss-dsi-lane-1-state;
		qcom,mdss-dsi-lane-2-state;
		qcom,mdss-dsi-lane-3-state;
		qcom,mdss-dsi-dma-trigger = "trigger_sw";
		qcom,mdss-dsi-mdp-trigger = "none";
		qcom,mdss-dsi-lp11-init;
		qcom,mdss-dsi-bl-pmic-control-type = "bl_ctrl_external";
		qcom,mdss-dsi-bl-min-level = <8>;
		qcom,mdss-dsi-bl-max-level = <2047>;
		qcom,mdss-brightness-max-level = <2047>;
		qcom,mdss-dsi-reset-sequence = <0 10>, <1 30>;
		qcom,mdss-pan-physical-width-dimension = <62>;
		qcom,mdss-pan-physical-height-dimension = <124>;
		//qcom,mdss-dsi-power-sequence;

		qcom,esd-check-enabled;
		qcom,mdss-dsi-panel-status-check-mode = "reg_read";
		qcom,mdss-dsi-panel-status-command = [06 01 00 01 00 00 01 09];
		qcom,mdss-dsi-panel-status-command-state = "dsi_hs_mode";
		qcom,mdss-dsi-panel-status-value = <0x80 0x73 0x04>;
		qcom,mdss-dsi-panel-on-check-value = <0x80 0x73 0x04>;
		qcom,mdss-dsi-panel-status-read-length = <3>;

		qcom,mdss-dsi-display-timings {
			timing@0 {
				qcom,mdss-dsi-panel-width = <720>;
				qcom,mdss-dsi-panel-height = <1440>;
				qcom,mdss-dsi-h-front-porch = <296>;//296
				qcom,mdss-dsi-h-back-porch = <80>;//80
				qcom,mdss-dsi-h-pulse-width = <40>;//40
				qcom,mdss-dsi-h-sync-skew = <0>;//
				qcom,mdss-dsi-v-front-porch = <17>;
				qcom,mdss-dsi-v-back-porch = <21>;
				qcom,mdss-dsi-v-pulse-width = <4>;//
				qcom,mdss-dsi-panel-framerate = <60>;
				qcom,mdss-dsi-on-command = [
				//----------------------LCD initial code start----------------------//
				//************* Start Initial Sequence **********//
				39 01 00 00 00 00 04 B9 F1 12 83
				39 01 00 00 00 00 04 B2 F0 22 30
				39 01 00 00 00 00 0B B3 10 10 28 28 03 FF 00 00 00 00
				15 01 00 00 00 00 02 B4 80
				39 01 00 00 00 00 03 B5 13 13
				//39 01 00 00 00 00 03 B6 97 97			
				15 01 00 00 00 00 02 B8 76
				39 01 00 00 00 00 1C BA 33 81 05 F9 0E 0E 20 00 00 00 00 00 00 00 44 25 00 90 0A 00 00 01 4F 01 7F 7F 37
				15 01 00 00 00 00 02 BC 4F
				39 01 00 00 00 00 04 BF 02 11 00
				39 01 00 00 00 00 0A C0 73 73 50 50 00 00 12 70 00
				39 01 00 00 00 00 0D C1 53 C0 32 32 77 E1 FF FF CC CC AA AA
				39 01 00 00 00 00 07 C6 82 00 BF FF 20 E0
				15 01 00 00 00 00 02 CC 0B
				39 01 00 00 00 00 23 E0 00 07 0B 2C 31 38 3E 3C 06 0D 0E 11 13 11 13 12 17 00 07 0B 2C 31 38 3E 3C 06 0D 0E 11 13 11 13 12 17
				39 01 00 00 00 00 0F E3 07 07 0B 0B 03 0B 00 00 00 00 FF 00 C0 10
				39 01 00 00 00 00 40 E9 C1 10 08 00 00 80 81 12 31 23 47 86 A0 51 47 08 00 00 0C 00 00 00 00 00 0C 00 00 00 88 20 46 02 88 88 88 88 88 88 FF 88 31 57 13 88 88 88 88 88 88 FF 00 00 00 00 00 00 00 00 00 00 00 00 00
				39 01 00 00 00 00 3E EA 00 1A 00 00 00 00 02 00 00 00 00 00 8F 13 31 75 88 88 88 88 88 88 F8 8F 02 20 64 88 88 88 88 88 88 F8 23 00 00 00 A4 00 00 00 00 00 00 00 00 00 00 00 00 00 00 00 00 00 00 00 00 00 00
				05 01 00 00 78 00 02 11 00
				05 01 00 00 14 00 02 29 00
				];
				qcom,mdss-dsi-off-command = [
				05 01 00 00 14 00 02 28 00
				05 01 00 00 78 00 02 10 00
				];
				qcom,mdss-dsi-on-command-state = "dsi_lp_mode";
				qcom,mdss-dsi-off-command-state = "dsi_lp_mode";
			};
		};
	};
};
